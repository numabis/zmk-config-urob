#define CONFIG_WIRELESS

/ {
    behaviors {
        magic: magic_behavior {
            compatible = "zmk,behavior-hold-tap";
            label = "MAGIC_HOLD_TAP";
            #binding-cells = <2>;
            flavor = "tap-preferred";
            tapping-term-ms = <200>;
            bindings = <&mo>, <&kp>;
        };
    };
};

// 2. Define the alias so the macro understands "MAGIC"
#define MAGIC &magic MAGIC 0

#define ZMK_BASE_LAYER(name, LT, RT, LM, RM, LB, RB, LH, RH)                                      \
ZMK_LAYER(                                                                                    \
        name,                                                                                     \
        &kp F1    &kp F2 &kp F3 &kp F4 &kp F5               &kp F6 &kp F7 &kp F8 &kp F9 &kp F10   \
        &kp GRAVE &kp N1 &kp N2 &kp N3 &kp N4 &kp N5 &kp N6 &kp N7 &kp N8 &kp N9 &kp N0 &kp MINUS \
        &kp TAB              LT                                            RT           &kp EQUAL \
        &kp CAPS             LM                                            RM           &kp RSHFT     \
        &kp LSHFT            LB NAV_LEFT  NAV_RIGHT  NAV_UP  &none  NAV_DEL  NAV_BSPC    RB           &kp RBKT     \
                                &none  &none &none                                                \
        &magic 0 0 &none LH NAV_DOWN                                      &none  RH    &kp PG_UP &none  \
                                                     &none &kp LBKT &kp BSLH)

#include "zmk-helpers/key-labels/glove80.h"
#include "base.keymap"
